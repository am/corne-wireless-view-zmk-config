## Kconfig
```kconfig
config NICE_VIEW_SIMPLE
    bool "Simple vertical nice!view status screen"
    depends on ZMK_DISPLAY && ZMK_DISPLAY_STATUS_SCREEN_CUSTOM
    select LV_USE_CANVAS
    help
      Connection, Bluetooth profile, layer and battery, laid out vertically
      for a nice!view mounted upright, as on a Corne. Drawn pixel for pixel
      from 1-bit icons in src/simple_view/assets.
      Requires CONFIG_NICE_VIEW_WIDGET_STATUS=n.

if NICE_VIEW_SIMPLE

config NICE_VIEW_SIMPLE_BASE_LAYER_SECOND
    bool "Show the base layer as the second tile of the layer stack"
    default y
    help
      The layer stack has one tile per keymap layer. With this option the
      base layer is the second tile from the bottom and the first layer
      above it in the keymap (usually "lower") is the bottom tile, so the
      stack reads lower, base, raise. Without it the tiles follow keymap
      order with the base layer at the bottom.

config NICE_VIEW_SIMPLE_ANIMATION
    bool "Animate the peripheral half's screen when it starts or connects"
    default y
    help
      The swell lines on the peripheral half move for one loop (128 frames)
      when the keyboard is switched on, reset or woken from deep sleep, and
      when the link to the central half comes up. They are still the rest of
      the time, so the display is not redrawn while typing.

config NICE_VIEW_SIMPLE_ANIMATION_FRAME_MS
    int "Time between animation frames, in milliseconds"
    default 80
    range 30 1000
    depends on NICE_VIEW_SIMPLE_ANIMATION

endif # NICE_VIEW_SIMPLE
```

## config/west.yml
```yaml
manifest:
  remotes:
    - name: zmkfirmware
      url-base: https://github.com/zmkfirmware
    - name: am
      url-base: https://github.com/am
  projects:
    - name: zmk
      remote: zmkfirmware
      revision: main
      import: app/west.yml
    - name: nice-view-strata
      remote: am
      revision: c4564ab7a6bc5ff3de761d926644ec2039bced56
  self:
    path: config
```
